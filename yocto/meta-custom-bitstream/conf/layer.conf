## yocto/meta-custom-bitstream/conf/layer.conf
```bitbake
# Layer configuration for a generic custom-bitstream/device-tree layer
# This layer can be reused for any project needing to inject build
# artifacts (bitstream/.dtb) generated by an external flow.

# See https://docs.yoctoproject.org for general information.

LCONF_VERSION = "7"

# Short description shown by bitbake-layers
LAYERSERIES_COMPAT_meta-custom = "hardknott kirkstone langdale master"

# Name of the externally generated DTS provided by the hardware flow.
HERMES_EXTERNAL_DTS ?= "system-top.dts"

# Name of the externally generated DTB provided by the hardware flow.
HERMES_EXTERNAL_DTB ?= "system-top.dtb"

BBPATH .= ":${LAYERDIR}"
BBFILES += "${LAYERDIR}/recipes-*/*/*.bb ${LAYERDIR}/recipes-*/*/*.bbappend"
```

## yocto/meta-custom-bitstream/conf/machine/hermes-k26.conf
```bitbake
# Hermes project machine configuration.
# Inherit the vendor machine and keep project overrides in our own layer.
require conf/machine/k26-smk-kr-sdt.conf

MACHINEOVERRIDES =. "hermes-k26:"

# Keep the expected external DTB name explicit for this machine.
HERMES_EXTERNAL_DTB ?= "system-top.dtb"
```
