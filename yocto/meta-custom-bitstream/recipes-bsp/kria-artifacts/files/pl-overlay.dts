/dts-v1/;
/plugin/;

/ {
	fragment@0 {
		target = <&amba>;
		__overlay__ {
			#address-cells = <2>;
			#size-cells = <2>;
			ranges;

			axi_intc_0: interrupt-controller@80000000 {
				#interrupt-cells = <2>;
				xlnx,sense-of-irq-edge-type = "Rising";
				xlnx,kind-of-intr = <0x0>;
				xlnx,kind-of-edge = <0xffffffff>;
				xlnx,irq-is-level = <1>;
				xlnx,has-ivr = <1>;
				compatible = "xlnx,axi-intc-4.1" , "xlnx,xps-intc-1.00.a";
				reg = <0x0 0x80000000 0x0 0x10000>;
				interrupt-controller;
				xlnx,name = "axi_intc_0";
			};

			axi_timer_0: timer@80010000 {
				interrupts = < 0 2 >;
				compatible = "xlnx,axi-timer-2.0" , "xlnx,xps-timer-1.00.a";
				clock-frequency = <0xbebbcca>;
				interrupt-parent = <&axi_intc_0>;
				xlnx,count-width = <32>;
				reg = <0x0 0x80010000 0x0 0x10000>;
				xlnx,mode-64bit = <0>;
				status = "okay";
				xlnx,enable-timer2 = <1>;
				interrupt-names = "interrupt";
				xlnx,name = "axi_timer_0";
			};
		};
	};
};
